## mqtt-dissector/Config.in
```kconfig
# libtins configuration
menu "Configuration"
	depends on PACKAGE_mqtt-dissector

config LIBTINS_ENABLE_TCP_STREAM_CUSTOM_DATA
	bool "Enable TCP stream custom data"
	default y
endmenu
```
